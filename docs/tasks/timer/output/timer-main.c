/* USER CODE BEGIN Header */
/**
  ******************************************************************************
  * @file           : main.c
  * @brief          : Reference implementation for timer task (Hardware Check)
  ******************************************************************************
  * 
  * UART Echo & Command Parsing + TIM3 Hardware Check
  * Board: STM32F429I-DISC1
  * 
  ******************************************************************************
  */
/* USER CODE END Header */

/* Includes ------------------------------------------------------------------*/
#include "main.h"

/* USER CODE BEGIN Includes */
#include <string.h>
#include <stdbool.h>
#include <stdio.h>
/* USER CODE END Includes */

/* Private typedef -----------------------------------------------------------*/
/* USER CODE BEGIN PTD */

/* USER CODE END PTD */

/* Private define ------------------------------------------------------------*/
/* USER CODE BEGIN PD */
#define RX_BUF_SIZE 128
#define LED_DURATION_MS 5000
/* USER CODE END PD */

/* Private macro -------------------------------------------------------------*/
/* USER CODE BEGIN PM */

/* USER CODE END PM */

/* Private variables ---------------------------------------------------------*/
TIM_HandleTypeDef htim3;
UART_HandleTypeDef huart1;

/* USER CODE BEGIN PV */
/* UART Rx Variables */
uint8_t rx_byte;
char rx_buffer[RX_BUF_SIZE];
volatile uint8_t rx_index = 0;
volatile bool line_ready = false;

/* LED Timer Variables (Software non-blocking timers) */
uint32_t led_green_start = 0;
bool led_green_active = false;
uint32_t led_red_start = 0;
bool led_red_active = false;

/* Hardware Timer Variables (Uptime Check) */
volatile uint32_t uptime_seconds = 0;       // Đếm số giây trôi qua từ TIM3
volatile bool heartbeat_ready = false;      // Cờ báo hiệu cần in heartbeat

/* Strings */
const char msg_welcome[] = "\r\n--- HW Timer & UART Ready ---\r\n";
const char msg_done[] = "DONE\r\n";
/* USER CODE END PV */

/* Private function prototypes -----------------------------------------------*/
void SystemClock_Config(void);
static void MX_GPIO_Init(void);
static void MX_USART1_UART_Init(void);
static void MX_TIM3_Init(void);
/* USER CODE BEGIN PFP */

/* USER CODE END PFP */

/* Private user code ---------------------------------------------------------*/
/* USER CODE BEGIN 0 */

/**
  * @brief  Hàm phục vụ ngắt nhận UART (Callback)
  *         Ưu tiên cao hơn (Preemption Priority = 1)
  */
void HAL_UART_RxCpltCallback(UART_HandleTypeDef *huart)
{
  if (huart->Instance == USART1)
  {
    /* Kiểm tra ký tự chốt chuỗi: CR hoặc LF */
    if (rx_byte == '\r' || rx_byte == '\n')
    {
      if (rx_index > 0 && !line_ready) // Bỏ qua chuỗi rỗng hoặc \n thừa
      {
        rx_buffer[rx_index] = '\0'; // Đóng chuỗi thành C-String
        line_ready = true;          // Dựng cờ báo cho Main loop xử lý
      }
    }
    else
    {
      /* Nhận byte bình thường, chỉ ghi khi chưa chốt chuỗi và còn chỗ */
      if (!line_ready)
      {
        if (rx_index < (RX_BUF_SIZE - 1))
        {
          rx_buffer[rx_index++] = rx_byte;
        }
        else
        {
          /* Tràn buffer: tự động đóng chuỗi để tránh ghi đè RAM */
          rx_buffer[RX_BUF_SIZE - 1] = '\0';
          line_ready = true;
        }
      }
    }

    /* BẮT BUỘC: Mồi lại ngắt để hứng byte tiếp theo */
    HAL_UART_Receive_IT(&huart1, &rx_byte, 1);
  }
}

/**
  * @brief  Hàm phục vụ ngắt tràn Timer (Period Elapsed Callback)
  *         Ưu tiên thấp hơn (Preemption Priority = 2)
  *         Hàm này tự động nhảy vào mỗi 1 giây (do PSC=15999, ARR=999)
  */
void HAL_TIM_PeriodElapsedCallback(TIM_HandleTypeDef *htim)
{
  if (htim->Instance == TIM3)
  {
    uptime_seconds++;         // Tăng biến đếm giây
    heartbeat_ready = true;   // Kích cờ để vòng lặp main in ra Terminal
                              // Tuyệt đối không gọi HAL_UART_Transmit trong ngắt!
  }
}
/* USER CODE END 0 */

/**
  * @brief  The application entry point.
  * @retval int
  */
int main(void)
{
  /* MCU Configuration--------------------------------------------------------*/
  HAL_Init();
  
  /* Configure the system clock */
  /* generated by CubeMX — see config §1 for HSI setup */
  SystemClock_Config();

  /* Initialize all configured peripherals */
  MX_GPIO_Init();
  MX_USART1_UART_Init();
  MX_TIM3_Init();
  /* USER CODE BEGIN 2 */

  /* Bật ngắt Hardware Timer đếm giây (TIM3) */
  HAL_TIM_Base_Start_IT(&htim3);

  /* In chuỗi khởi động */
  HAL_UART_Transmit(&huart1, (uint8_t*)msg_welcome, strlen(msg_welcome), HAL_MAX_DELAY);

  /* Mồi ngắt UART lần đầu tiên */
  HAL_UART_Receive_IT(&huart1, &rx_byte, 1);

  /* Đảm bảo 2 đèn LED đang tắt */
  HAL_GPIO_WritePin(GPIOG, GPIO_PIN_13, GPIO_PIN_RESET);
  HAL_GPIO_WritePin(GPIOG, GPIO_PIN_14, GPIO_PIN_RESET);

  /* USER CODE END 2 */

  /* Infinite loop */
  /* USER CODE BEGIN WHILE */
  char tx_buf[128]; // Buffer cục bộ để tạo chuỗi in ra màn hình
  
  while (1)
  {
    /* -----------------------------------------------------------
     * 1. XỬ LÝ HEARTBEAT (Ngắt Timer gửi tín hiệu ra Terminal)
     * ----------------------------------------------------------- */
    if (heartbeat_ready)
    {
      heartbeat_ready = false; // Hạ cờ
      
      /* In ra heartbeat chứng minh MCU không bị treo */
      snprintf(tx_buf, sizeof(tx_buf), "[HW_TIMER] Heartbeat... Uptime: %lu s\r\n", uptime_seconds);
      HAL_UART_Transmit(&huart1, (uint8_t*)tx_buf, strlen(tx_buf), HAL_MAX_DELAY);
    }

    /* -----------------------------------------------------------
     * 2. XỬ LÝ LỆNH TỪ UART (Kế thừa bài tập trước)
     * ----------------------------------------------------------- */
    if (line_ready)
    {
      /* Echo chuỗi vừa nhận ngược lại màn hình */
      HAL_UART_Transmit(&huart1, (uint8_t*)"Echo: ", 6, HAL_MAX_DELAY);
      HAL_UART_Transmit(&huart1, (uint8_t*)rx_buffer, strlen(rx_buffer), HAL_MAX_DELAY);
      HAL_UART_Transmit(&huart1, (uint8_t*)"\r\n", 2, HAL_MAX_DELAY);

      /* Phân tích lệnh điều khiển */
      if (strcmp(rx_buffer, "LED_GREEN") == 0)
      {
        HAL_GPIO_WritePin(GPIOG, GPIO_PIN_13, GPIO_PIN_SET);
        led_green_active = true;
        led_green_start = HAL_GetTick(); 
      }
      else if (strcmp(rx_buffer, "LED_RED") == 0)
      {
        HAL_GPIO_WritePin(GPIOG, GPIO_PIN_14, GPIO_PIN_SET);
        led_red_active = true;
        led_red_start = HAL_GetTick();
      }
      else if (strcmp(rx_buffer, "GET_TIME") == 0)
      {
        snprintf(tx_buf, sizeof(tx_buf), "--> Current Uptime: %lu seconds\r\n", uptime_seconds);
        HAL_UART_Transmit(&huart1, (uint8_t*)tx_buf, strlen(tx_buf), HAL_MAX_DELAY);
      }
      else if (strcmp(rx_buffer, "CHECK_HW") == 0)
      {
        /* Đọc trực tiếp các thanh ghi cấu trúc của TIM3 để kiểm chứng phần cứng */
        uint32_t cnt = TIM3->CNT;
        uint32_t psc = TIM3->PSC;
        uint32_t arr = TIM3->ARR;
        snprintf(tx_buf, sizeof(tx_buf), "--> HW REG: CNT=%lu, PSC=%lu, ARR=%lu\r\n", cnt, psc, arr);
        HAL_UART_Transmit(&huart1, (uint8_t*)tx_buf, strlen(tx_buf), HAL_MAX_DELAY);
      }
      else
      {
        HAL_UART_Transmit(&huart1, (uint8_t*)"Unknown Command\r\n", 17, HAL_MAX_DELAY);
      }

      /* Xóa buffer và hạ cờ để hứng lệnh tiếp theo */
      rx_index = 0;
      line_ready = false; 
    }

    /* -----------------------------------------------------------
     * 3. QUẢN LÝ THỜI GIAN ĐÈN LED (NON-BLOCKING)
     * ----------------------------------------------------------- */
    if (led_green_active)
    {
      if ((HAL_GetTick() - led_green_start) >= LED_DURATION_MS)
      {
        HAL_GPIO_WritePin(GPIOG, GPIO_PIN_13, GPIO_PIN_RESET);
        led_green_active = false;
        HAL_UART_Transmit(&huart1, (uint8_t*)msg_done, strlen(msg_done), HAL_MAX_DELAY);
      }
    }

    if (led_red_active)
    {
      if ((HAL_GetTick() - led_red_start) >= LED_DURATION_MS)
      {
        HAL_GPIO_WritePin(GPIOG, GPIO_PIN_14, GPIO_PIN_RESET);
        led_red_active = false;
        HAL_UART_Transmit(&huart1, (uint8_t*)msg_done, strlen(msg_done), HAL_MAX_DELAY);
      }
    }

    /* USER CODE END WHILE */

    /* USER CODE BEGIN 3 */
  }
  /* USER CODE END 3 */
}
