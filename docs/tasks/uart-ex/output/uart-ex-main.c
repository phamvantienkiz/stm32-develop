/* USER CODE BEGIN Header */
/**
  ******************************************************************************
  * @file           : main.c
  * @brief          : Reference implementation for uart-ex task
  ******************************************************************************
  * 
  * UART Echo & Command Parsing using Non-blocking Logic
  * Board: STM32F429I-DISC1
  * 
  ******************************************************************************
  */
/* USER CODE END Header */

/* Includes ------------------------------------------------------------------*/
#include "main.h"

/* USER CODE BEGIN Includes */
#include <string.h>
#include <stdbool.h>
#include <stdio.h>
/* USER CODE END Includes */

/* Private typedef -----------------------------------------------------------*/
/* USER CODE BEGIN PTD */

/* USER CODE END PTD */

/* Private define ------------------------------------------------------------*/
/* USER CODE BEGIN PD */
#define RX_BUF_SIZE 128
#define LED_DURATION_MS 5000
/* USER CODE END PD */

/* Private macro -------------------------------------------------------------*/
/* USER CODE BEGIN PM */

/* USER CODE END PM */

/* Private variables ---------------------------------------------------------*/
UART_HandleTypeDef huart1;

/* USER CODE BEGIN PV */
/* UART Rx Variables */
uint8_t rx_byte;                        // Biến chứa 1 byte hứng từ ngắt
char rx_buffer[RX_BUF_SIZE];            // Line buffer chứa chuỗi
volatile uint8_t rx_index = 0;          // Vị trí con trỏ ghi vào buffer
volatile bool line_ready = false;       // Cờ báo hiệu đã nhận xong 1 dòng (\r hoặc \n)

/* LED Timer Variables */
uint32_t led_green_start = 0;           // Thời điểm bắt đầu sáng đèn xanh
bool led_green_active = false;          // Đèn xanh đang sáng?
uint32_t led_red_start = 0;             // Thời điểm bắt đầu sáng đèn đỏ
bool led_red_active = false;            // Đèn đỏ đang sáng?

/* Chuỗi mẫu để truyền đi */
const char msg_welcome[] = "\r\n--- UART Command Ready ---\r\n";
const char msg_done[] = "DONE\r\n";
const char msg_error[] = "Error: Buffer Overflow\r\n";
/* USER CODE END PV */

/* Private function prototypes -----------------------------------------------*/
void SystemClock_Config(void);
static void MX_GPIO_Init(void);
static void MX_USART1_UART_Init(void);
/* USER CODE BEGIN PFP */

/* USER CODE END PFP */

/* Private user code ---------------------------------------------------------*/
/* USER CODE BEGIN 0 */

/**
  * @brief  Hàm phục vụ ngắt nhận UART (Callback)
  *         Được gọi tự động bởi HAL khi có 1 byte nhảy vào USART1
  */
void HAL_UART_RxCpltCallback(UART_HandleTypeDef *huart)
{
  if (huart->Instance == USART1)
  {
    /* Kiểm tra ký tự chốt chuỗi: CR hoặc LF */
    if (rx_byte == '\r' || rx_byte == '\n')
    {
      if (rx_index > 0 && !line_ready) // Bỏ qua chuỗi rỗng hoặc \n thừa
      {
        rx_buffer[rx_index] = '\0'; // Đóng chuỗi thành C-String hợp lệ
        line_ready = true;          // Dựng cờ báo cho Main loop xử lý
      }
    }
    else
    {
      /* Nhận byte bình thường, chỉ ghi khi chưa chốt chuỗi và còn chỗ */
      if (!line_ready)
      {
        if (rx_index < (RX_BUF_SIZE - 1))
        {
          rx_buffer[rx_index++] = rx_byte;
        }
        else
        {
          /* Tràn buffer: tự động đóng chuỗi để tránh ghi đè RAM */
          rx_buffer[RX_BUF_SIZE - 1] = '\0';
          line_ready = true;
        }
      }
      /* (Lưu ý: Nếu line_ready đang = true mà main chưa kịp xử lý, 
         các byte gõ thêm sẽ bị bỏ qua an toàn) */
    }

    /* BẮT BUỘC: Mồi lại ngắt để hứng byte tiếp theo */
    HAL_UART_Receive_IT(&huart1, &rx_byte, 1);
  }
}
/* USER CODE END 0 */

/**
  * @brief  The application entry point.
  * @retval int
  */
int main(void)
{
  /* USER CODE BEGIN 1 */

  /* USER CODE END 1 */

  /* MCU Configuration--------------------------------------------------------*/

  /* Reset of all peripherals, Initializes the Flash interface and the Systick. */
  HAL_Init();

  /* USER CODE BEGIN Init */

  /* USER CODE END Init */

  /* Configure the system clock */
  /* generated by CubeMX — see config §5 for the settings */
  SystemClock_Config();

  /* USER CODE BEGIN SysInit */

  /* USER CODE END SysInit */

  /* Initialize all configured peripherals */
  MX_GPIO_Init();
  MX_USART1_UART_Init();
  /* USER CODE BEGIN 2 */

  /* In chuỗi khởi động (Truyền đồng bộ) */
  HAL_UART_Transmit(&huart1, (uint8_t*)msg_welcome, strlen(msg_welcome), HAL_MAX_DELAY);

  /* Kích hoạt ngắt nhận UART lần đầu tiên */
  HAL_UART_Receive_IT(&huart1, &rx_byte, 1);

  /* Đảm bảo 2 đèn LED đang tắt */
  HAL_GPIO_WritePin(GPIOG, GPIO_PIN_13, GPIO_PIN_RESET);
  HAL_GPIO_WritePin(GPIOG, GPIO_PIN_14, GPIO_PIN_RESET);

  /* USER CODE END 2 */

  /* Infinite loop */
  /* USER CODE BEGIN WHILE */
  while (1)
  {
    /* 1. XỬ LÝ LỆNH TỪ UART */
    if (line_ready)
    {
      /* Echo chuỗi vừa nhận ngược lại màn hình (thêm \r\n để dễ nhìn) */
      HAL_UART_Transmit(&huart1, (uint8_t*)"Echo: ", 6, HAL_MAX_DELAY);
      HAL_UART_Transmit(&huart1, (uint8_t*)rx_buffer, strlen(rx_buffer), HAL_MAX_DELAY);
      HAL_UART_Transmit(&huart1, (uint8_t*)"\r\n", 2, HAL_MAX_DELAY);

      /* Phân tích lệnh điều khiển */
      if (strcmp(rx_buffer, "LED_GREEN") == 0)
      {
        HAL_GPIO_WritePin(GPIOG, GPIO_PIN_13, GPIO_PIN_SET);
        led_green_active = true;
        led_green_start = HAL_GetTick(); // Ghi nhận mốc thời gian bắt đầu
      }
      else if (strcmp(rx_buffer, "LED_RED") == 0)
      {
        HAL_GPIO_WritePin(GPIOG, GPIO_PIN_14, GPIO_PIN_SET);
        led_red_active = true;
        led_red_start = HAL_GetTick();
      }
      else
      {
        HAL_UART_Transmit(&huart1, (uint8_t*)"Unknown Command\r\n", 17, HAL_MAX_DELAY);
      }

      /* Xóa buffer và hạ cờ để hứng lệnh tiếp theo */
      rx_index = 0;
      line_ready = false; 
    }

    /* 2. QUẢN LÝ THỜI GIAN ĐÈN LED_GREEN (NON-BLOCKING) */
    if (led_green_active)
    {
      /* Tính khoảng thời gian đã trôi qua kể từ lúc bật đèn */
      uint32_t now = HAL_GetTick();
      if ((now - led_green_start) >= LED_DURATION_MS)
      {
        HAL_GPIO_WritePin(GPIOG, GPIO_PIN_13, GPIO_PIN_RESET); // Tắt đèn
        led_green_active = false;
        HAL_UART_Transmit(&huart1, (uint8_t*)msg_done, strlen(msg_done), HAL_MAX_DELAY);
      }
    }

    /* 3. QUẢN LÝ THỜI GIAN ĐÈN LED_RED (NON-BLOCKING) */
    if (led_red_active)
    {
      uint32_t now = HAL_GetTick();
      if ((now - led_red_start) >= LED_DURATION_MS)
      {
        HAL_GPIO_WritePin(GPIOG, GPIO_PIN_14, GPIO_PIN_RESET);
        led_red_active = false;
        HAL_UART_Transmit(&huart1, (uint8_t*)msg_done, strlen(msg_done), HAL_MAX_DELAY);
      }
    }

    /* USER CODE END WHILE */

    /* USER CODE BEGIN 3 */
  }
  /* USER CODE END 3 */
}
